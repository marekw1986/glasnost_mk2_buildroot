## external/Config.in
```kconfig
# custom packages go here, e.g.:
# source "$BR2_EXTERNAL_GLASNOST_MK2_PATH/package/foo/Config.in"

menu "Glasnost applications"

source "$BR2_EXTERNAL_GLASNOST_MK2_PATH/package/testapp/Config.in"

endmenu
```

## external/configs/glasnost_mk2_defconfig
```kconfig
BR2_arm=y
BR2_TOOLCHAIN_BUILDROOT_MUSL=y
BR2_KERNEL_HEADERS_6_1=y
BR2_TARGET_GENERIC_HOSTNAME="glasnost"
BR2_TARGET_GENERIC_GETTY_PORT="ttyS0"
BR2_TARGET_GENERIC_GETTY_BAUDRATE_115200=y
BR2_ROOTFS_POST_IMAGE_SCRIPT="$(BR2_EXTERNAL_GLASNOST_MK2_PATH)/board/glasnost_mk2/copy-extlinux.sh support/scripts/genimage.sh"
BR2_ROOTFS_POST_SCRIPT_ARGS="-c $(BR2_EXTERNAL_GLASNOST_MK2_PATH)/board/glasnost_mk2/genimage.cfg"
BR2_LINUX_KERNEL=y
BR2_LINUX_KERNEL_CUSTOM_VERSION=y
BR2_LINUX_KERNEL_CUSTOM_VERSION_VALUE="6.1.118"
BR2_LINUX_KERNEL_DEFCONFIG="at91_dt"
BR2_LINUX_KERNEL_CONFIG_FRAGMENT_FILES="$(BR2_EXTERNAL_GLASNOST_MK2_PATH)/board/glasnost_mk2/linux.fragment"
BR2_LINUX_KERNEL_DTS_SUPPORT=y
BR2_LINUX_KERNEL_CUSTOM_DTS_PATH="$(BR2_EXTERNAL_GLASNOST_MK2_PATH)/board/glasnost_mk2/glasnost_mk2.dts"
BR2_TARGET_ROOTFS_EXT2=y
BR2_TARGET_ROOTFS_EXT2_4=y
BR2_TARGET_ROOTFS_EXT2_SIZE="200M"
BR2_PACKAGE_HOST_DOSFSTOOLS=y
BR2_PACKAGE_HOST_GENIMAGE=y
BR2_PACKAGE_HOST_MTOOLS=y
BR2_PACKAGE_HOST_UBOOT_TOOLS=y
```

## external/package/testapp/Config.in
```kconfig
config BR2_PACKAGE_TESTAPP
    bool "testapp"
    help
      My custom application.
```
